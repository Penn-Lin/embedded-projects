#include <Wire.h>
#include <U8g2lib.h>
#include <math.h>
#include <avr/pgmspace.h>
U8G2_SSD1306_128X64_NONAME_F_HW_I2C u8g2(U8G2_R0, /* reset=*/U8X8_PIN_NONE);

// ================= 硬件配置 =================
const int BUTTON_K1 = 2;    // 总开关（OLED+蜂鸣器）
const int BUTTON_K2 = 4;    // 动画切换
const int BUTTON_K3 = 7;    // 音效切换
const int BUTTON_K4 = 5;    // 党徽显示控制
bool systemActive = false;  // 系统激活状态
bool badgeMode = false;     // 徽章显示模式
int animationMode = 0;      // 动画模式：0=五角星，1=红旗
int soundMode = 0;          // 音效模式：0=小星星，1=东方红

// ================= 显示屏配置 =================
int xOffset = 0;            // 五角星偏移量
float waveOffset = 0.0;     // 红旗波浪偏移
const int MOVE_SPEED = 2;   // 五角星移动速度
const int MAX_OFFSET = 40;  // 五角星最大偏移
float waveSpeed = 0.2;      // 红旗波浪速度
float waveAmplitude = 3.0;  // 红旗波浪幅度
int moveDirection = 1;

// ================= 红旗参数 =================
int flagWidth = 70;
int flagHeight = 38;
int flagX = 30;
int flagY = 20;

// ================= 蜂鸣器配置 =================
#define BUZZER_PIN 3
unsigned long previousMusicTime = 0;
int currentNote = 0;
int noteDuration = 500;  // 基础节拍时长

// 默认乐谱（小星星）
const uint16_t PROGMEM defaultNotes[] = {
  262,
  262,
  392,
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  294,
};
int defaultNoteCount = sizeof(defaultNotes) / sizeof(int);
// 默认音乐（小星星）的持续时间
const uint16_t PROGMEM defaultDurations[] = {
  500,
  500,
  500,
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  1000,
};

// 没有共产党就没有新中国
int customNotes[] = {
  330,
  330,
  392,
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  392,
};
int customNoteCount = sizeof(customNotes) / sizeof(int);

int customDurations[] = {
  600, 600, 600, 600, 600, 600, 1200,       // 没有共产党就没有新中国
  600, 600, 600, 600, 600, 600, 600, 1200,  // 没有共产党就没有新中国
  600, 600, 600, 600, 600, 600, 1200,       // 共产党辛劳为民族
  600, 600, 600, 600, 600, 600, 600, 1200,  // 共产党他一心救中国
};
// 播放《没有共产党就没有新中国》
void playMeiyouGongchandang() {
  static int noteIndex = 0;
  int noteCount = sizeof(customNotes) / sizeof(int);

  if (millis() - previousMusicTime >= noteDuration) {
    if (noteIndex < noteCount) {
      tone(BUZZER_PIN, customNotes[noteIndex], customDurations[noteIndex]);
      previousMusicTime = millis();
      noteIndex++;
    } else {
      noteIndex = 0;  // 循环播放
    }
  }
}

// 东方红乐谱（存入Flash）
const uint16_t PROGMEM dongfanghongNotes[] = {
  523,523,587,392,349,349,294,392,
  523,523,587,698,587,523,349,349,294,392,
  523,392,349,330,294,262,523,392,
};
const uint16_t PROGMEM dongfanghongDurations[] = {
  500,250,250,1000,500,250,250,1000,
  500,500,250,250,250,250,500,250,250,1000,
  500,500,500,250,250,500,500,500,
};

// ================= 五角星绘图函数 =================
void calculateStarPoints(int centerX, int centerY, int outerRadius, int innerRadius, int points[20]) {
  float angleOffset = -PI / 2;
  float step = TWO_PI / 5;
  for (int i = 0; i < 5; i++) {
    float outerAngle = angleOffset + step * i;
    points[2 * i] = centerX + outerRadius * cos(outerAngle);
    points[2 * i + 1] = centerY + outerRadius * sin(outerAngle);
    float innerAngle = outerAngle + step / 2;
    points[2 * i + 10] = centerX + innerRadius * cos(innerAngle);
    points[2 * i + 11] = centerY + innerRadius * sin(innerAngle);
  }
}

void drawStar(int offsetX) {
  int centerX = u8g2.getDisplayWidth() / 2 + offsetX;
  int centerY = u8g2.getDisplayHeight() / 2 + 10;
  int outerRadius = 25;
  int innerRadius = outerRadius * 0.382;
  int points[20];
  calculateStarPoints(centerX, centerY, outerRadius, innerRadius, points);

  u8g2.setDrawColor(1);
  for (int i = 0; i < 5; i++) {
    int next = (i + 2) % 5;
    u8g2.drawLine(points[2 * i], points[2 * i + 1], points[2 * next + 10], points[2 * next + 11]);
  }
  for (int i = 0; i < 5; i++) {
    int next = (i + 2) % 5;
    u8g2.drawTriangle(
      points[2 * i], points[2 * i + 1],
      points[2 * next + 10], points[2 * next + 11],
      points[2 * next], points[2 * next + 1]);
  }
}

// ================= 红旗绘制函数 =================
void drawFlagpole() {
  int poleTop = flagY - 10;
  int poleBottom = flagY + flagHeight + 5;
  int poleX = flagX - 2;
  u8g2.drawLine(poleX, poleTop, poleX, poleBottom);
  u8g2.drawCircle(poleX, poleTop, 2);
  u8g2.drawCircle(poleX, poleTop, 1);
  u8g2.drawLine(poleX - 3, poleBottom, poleX + 3, poleBottom);
}

void drawFlag() {
  // 只清空红旗区域，保留其他UI元素
  u8g2.clearBuffer();

  // 绘制带有波浪效果的红旗
  for (int x = 0; x < flagWidth; x++) {
    float yOffset = sin((x + flagX) * 0.05 + waveOffset) * waveAmplitude;
    for (int y = 0; y < flagHeight; y++) {
      u8g2.drawPixel(x + flagX, y + flagY + yOffset);
    }
  }
  drawFlagpole();
  u8g2.sendBuffer();
}

// ================= 党徽位图数据 =================
const unsigned char party_logo[] PROGMEM = {
  0x00, 0x00, 0x00, 0x00, 0x00, 0x00, 0x00, 0x00, 0x0c, 0x00, 0x00, 0x00, 0x00, 0x00, 0x00, 0x00,
  0x00, 0x00, 0x00, 0x00, 0x00, 0x00, 0x00, 0x00, 0xf0, 0x01, 0x00, 0x00, 0x00, 0x00, 0x00, 0x00,
  0x00, 0x00, 0x00, 0x00, 0x00, 0x00, 0x00, 0x00, 0xe0, 0x0f, 0x00, 0x00, 0x00, 0x00, 0x00, 0x00,
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  0x00, 0x00, 0x00, 0x00, 0x78, 0x00, 0x00, 0xf0, 0x0f, 0x00, 0x00, 0x00, 0x00, 0x00, 0x00, 0x00
};

// ================= 按键检测函数 =================
bool checkButton(int pin) {
  static unsigned long lastDebounceTime[4] = { 0 };
  const int debounceDelay = 50;
  int index = 0;
  if (pin == BUTTON_K1) index = 0;
  else if (pin == BUTTON_K2) index = 1;
  else if (pin == BUTTON_K3) index = 2;
  else if (pin == BUTTON_K4) index = 3;

  if (digitalRead(pin) == LOW) {
    if (millis() - lastDebounceTime[index] > debounceDelay) {
      lastDebounceTime[index] = millis();
      return true;
    }
  }
  return false;
}

// ================= 显示函数优化 =================
void drawBadge() {
  u8g2.clearBuffer();
  // 关键修改：使用支持PROGMEM的显示方法
  u8g2.drawXBMP(0, 0, 128, 64, party_logo);
  u8g2.sendBuffer();
}

// ================= 音乐播放 =================
void handleMusic() {
  const uint16_t* currentNotes;
  const uint16_t* currentDurations;
  int noteCount;

  if (soundMode == 0) {
    currentNotes = defaultNotes;
    currentDurations = defaultDurations;
    noteCount = sizeof(defaultNotes) / sizeof(uint16_t);
  } else {
    currentNotes = dongfanghongNotes;
    currentDurations = dongfanghongDurations;
    noteCount = sizeof(dongfanghongNotes) / sizeof(uint16_t);
  }

  if (millis() - previousMusicTime >= noteDuration) {
    if (currentNote < noteCount) {
      // 从Flash读取数据
      uint16_t note = pgm_read_word(&currentNotes[currentNote]);
      uint16_t duration = pgm_read_word(&currentDurations[currentNote]);

      tone(BUZZER_PIN, note, duration);
      previousMusicTime = millis();
      currentNote++;
    } else {
      currentNote = 0;
    }
  }
}

// ================= 主程序 =================
void setup() {
  u8g2.begin();

  pinMode(BUZZER_PIN, OUTPUT);
  pinMode(BUTTON_K1, INPUT_PULLUP);
  pinMode(BUTTON_K2, INPUT_PULLUP);
  pinMode(BUTTON_K3, INPUT_PULLUP);
  pinMode(BUTTON_K4, INPUT_PULLUP);
  u8g2.clearBuffer();
  u8g2.sendBuffer();
}

void loop() {
  // 检测K1（系统总开关）
  if (checkButton(BUTTON_K1)) {
    systemActive = !systemActive;
    noTone(BUZZER_PIN);
    badgeMode = false;  // 强制退出徽章模式
    if (!systemActive) {
      u8g2.clearBuffer();
      u8g2.sendBuffer();
    }
    currentNote = 0;
    delay(300);
  }

  if (!systemActive) return;  // 系统未激活时直接返回

  // 检测K4（徽章模式 - 显示党徽并播放《没有共产党就没有新中国》）
  if (checkButton(BUTTON_K4)) {
    badgeMode = !badgeMode;
    currentNote = 0;
    previousMusicTime = millis();
    noTone(BUZZER_PIN);  // 停止当前音乐

    delay(300);
  }

  // K2动画切换
  if (checkButton(BUTTON_K2)) {
    animationMode = (animationMode + 1) % 2;
    currentNote = 0;
    u8g2.clearBuffer();  // 清屏
    // 重置动画参数
    xOffset = 0;
    waveOffset = 0.0;
    delay(300);  // 增加短暂延迟确保显示稳定
  }

  // 检测K3（音效切换 - 在《东方红》和《小星星》之间切换）
  if (checkButton(BUTTON_K3) && !badgeMode) {  // 仅在非徽章模式下切换
    soundMode = (soundMode + 1) % 2;           // 0:小星星, 1:东方红
    currentNote = 0;
    noTone(BUZZER_PIN);
    delay(300);
  }

  // 处理徽章模式
  if (badgeMode) {
    drawBadge();  // 显示党徽
    // 播放《没有共产党就没有新中国》
    playMeiyouGongchandang();  // 新增的播放函数
  } else {
    // 非徽章模式：更新动画
    if (animationMode == 0) {  // 五角星模式
      u8g2.clearBuffer();
      drawStar(xOffset);
      u8g2.sendBuffer();
      xOffset += moveDirection * MOVE_SPEED;
      if (xOffset >= MAX_OFFSET || xOffset <= -MAX_OFFSET) moveDirection *= -1;
    } else {  // 红旗模式
      waveOffset += waveSpeed;
      if (waveOffset > TWO_PI) waveOffset -= TWO_PI;
      drawFlag();
    }
  }

  // 统一音乐播放逻辑
  if (systemActive && !badgeMode) {
    handleMusic();
  }

  delay(30);
}